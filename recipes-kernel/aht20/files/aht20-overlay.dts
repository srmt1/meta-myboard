/dts-v1/;
/plugin/;

/ {
    compatible = "brcm,bcm2835";

    fragment@0 {
        target = <&i2c1>;

        __overlay__ {
            status = "okay";

            aht20@38 {
                compatible = "aosong,aht20";
                reg = <0x38>;
            };
        };
    };
};

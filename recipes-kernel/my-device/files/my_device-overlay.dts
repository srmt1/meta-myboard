/dts-v1/;
/plugin/;

/ {
    compatible = "brcm,bcm2835";

    fragment@0 {
        target-path = "/";
        __overlay__ {
            my_device {
                compatible = "example,my-device";
                status = "okay";
            };
        };
    };
};

